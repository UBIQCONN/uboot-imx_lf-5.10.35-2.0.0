## board/freescale/imx8mp_tmg/Kconfig
```kconfig
if TARGET_IMX8MP_TMG

config SYS_BOARD
	default "imx8mp_tmg"

config SYS_VENDOR
	default "freescale"

config SYS_CONFIG_NAME
	default "imx8mp_tmg"

source "board/freescale/common/Kconfig"

endif
```
